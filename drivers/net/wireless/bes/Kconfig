## drivers/net/wireless/bes/bes2610/Kconfig
```kconfig
config BES2610
	tristate "BES2610 WLAN support"
	select CFG80211
	default m
	help
		This is an experimental driver for the bes2005 chip-set.
		Enabling this option enables the generic driver without
		any platform support.
```

## drivers/nfc/dummy_nfc/Kconfig
```kconfig
#
# OPLUS NFC TEST devices
#

config NFC_DUMMY_DEVICE
	tristate "OPLUS NFC TEST devices"
	help
	  This adds support to use oplus mcu nfc test driver.

	  If unsure, say N.
```

## drivers/oplus/boot/cmdline_parser/Kconfig
```kconfig
# SPDX-License-Identifier: GPL-2.0-only
# Copyright (C) 2018-2023 Oplus. All rights reserved.

config OPLUS_FEATURE_CMDLINE
	tristate "Oplus command line"
	default n
	select OPLUS_FEATURE_BUILDVARIANT
	select OPLUS_FEATURE_OPLUSBOOT
	select OPLUS_FEATURE_FTMMODE
	select OPLUS_FEATURE_CHARGERPRESENT
	select OPLUS_FEATURE_SIMCARDNUM
	select OPLUS_FEATURE_CDT
	select OPLUS_FEATURE_SHUTDOWN_SPEED
	select OPLUS_FEATURE_BOOTARGS
	help
	  define this config to get command line.

config OPLUS_FEATURE_OPLUSBOOT
	tristate "Oplus android boot"
	default n
	help
	  define this config to get android boot cmdline.

config OPLUS_FEATURE_FTMMODE
	tristate "Oplus ftm mode"
	default n
	help
	  define this config to get ftm mode cmdline.

config OPLUS_FEATURE_CHARGERPRESENT
	tristate "Oplus charger present"
	default n
	help
	  define this config to get charger present cmdline.

config OPLUS_FEATURE_BUILDVARIANT
	tristate "Oplus buildvariant"
	default n
	help
	  define this config to get buildvariant cmdline.

config OPLUS_FEATURE_SIMCARDNUM
	tristate "Oplus simcardnum"
	default n
	help
	  define this config to get simcardnum cmdline.

config OPLUS_FEATURE_CDT
	tristate "Oplus cdt"
	default n
	help
	  define this config to get cdt_integrity cmdline.

config OPLUS_FEATURE_SHUTDOWN_SPEED
	tristate "Oplus shutdown speed"
	default n
	help
	  define this config to get shutdown_speed cmdline.

config OPLUS_FEATURE_BOOTARGS
	tristate "Oplus bootargs"
	default n
	help
	  try to get boot cmdline.
```

## drivers/oplus/oplus_crown/Kconfig
```kconfig
config OPLUS_CROWN
	tristate "config oplus crown"
	help
	  define this config for oplus crown feature.
```
